## conf/layer.conf
```bitbake
# We have a conf and classes directory, add to BBPATH
BBPATH .= ":${LAYERDIR}"

# We have recipes-* directories, add to BBFILES
BBFILES += "${LAYERDIR}/recipes-*/*/*.bb \
            ${LAYERDIR}/recipes-*/*/*.bbappend"

BBFILE_COLLECTIONS += "meta-bl808"
BBFILE_PATTERN_meta-bl808 = "^${LAYERDIR}/"
BBFILE_PRIORITY_meta-bl808 = "7"

#LAYERDEPENDS_meta-bl808 = "meta-riscv meta-external-toolchain"
LAYERSERIES_COMPAT_meta-bl808 = "kirkstone langdale"

BINUVERSION = "2.35"
#GLIBCVERSION = "2.35"
```

## conf/machine/bl808.conf
```bitbake
#@TYPE: Machine
#@NAME: BoufalloLabs BL808 baremetal machine
#@DESCRIPTION: Machine configuration for running on a Boufallo Labs BL808 D0 CPU

DEFAULTTUNE = "riscv64"

TUNE_FEATURES:tune-riscv32 = "riscv32"
TUNE_ARCH:tune-riscv32 = "riscv32"
TUNE_PKGARCH:tune-riscv32 = "riscv32"
PACKAGE_EXTRA_ARCHS:tune-riscv32 = "riscv32"

require conf/machine/include/riscv/tune-riscv.inc

MACHINE_FEATURES = "ext2 ext3 serial"
MACHINE_FEATURES:remove = " rtc"
PREFERRED_VERSION_openocd-native = "riscv"
PREFERRED_VERSION_openocd = "riscv"
PREFERRED_PROVIDER_virtual/kernel = "linux-bl808"
PREFERRED_PROVIDER_virtual/bootloader ?= "u-boot"

PREFERRED_PROVIDER_virtual/${TARGET_PREFIX}binutils = "binutils-cross-${TARGET_ARCH}"
PREFERRED_PROVIDER_virtual/${TARGET_PREFIX}gcc = "gcc-cross-${TARGET_ARCH}"
PREFERRED_PROVIDER_virtual/${TARGET_PREFIX}g++ = "gcc-cross-${TARGET_ARCH}"
PREFERRED_PROVIDER_virtual/${TARGET_PREFIX}compilerlibs = "gcc-runtime"
PREFERRED_PROVIDER_gdb = "gdb"

PREFERRED_PROVIDER_virtual/${SDK_PREFIX}binutils-crosssdk ?= "binutils-crosssdk-${SDK_SYS}"
PREFERRED_PROVIDER_virtual/${SDK_PREFIX}gcc = "gcc-crosssdk-${SDK_SYS}"
PREFERRED_PROVIDER_virtual/${SDK_PREFIX}g++ = "gcc-crosssdk-${SDK_SYS}"
PREFERRED_PROVIDER_virtual/${SDK_PREFIX}compilerlibs = "nativesdk-gcc-runtime"

TCLIBC = "glibc"

SERIAL_CONSOLES = "2000000;ttyS0"

TUNE_CCARGS:append = "-mabi=lp64d -mtune=c906"
#TUNE_CCARGS:append = "-mabi=lp64d -march=rv64imafdcv0p7_zfh_xtheadc -mtune=c906"

IMAGE_BOOT_FILES = "Image bl808-sipeed-m1s.dtb bl808-pine64-ox64.dtb bl808-firmware.bin boot-pine64.scr boot-m1s.scr boot.scr"

EXTRA_IMAGEDEPENDS += "opensbi u-boot bl808-firmware"
RISCV_SBI_PLAT ?= "generic"

UBOOT_MACHINE = "ox64_d0_defconfig"

KERNEL_IMAGETYPE = "Image"

#xuantie toolchain is at 10.2.0
GCCVERSION ?= "10.2.%"
SDKGCCVERSION ?= "${GCCVERSION}"
BINUVERSION ?= "2.35"
GLIBCVERSION ?= "2.33"
QEMUVERSION ?= "6.1.0"


PREFERRED_VERSION_gcc ?= "${GCCVERSION}"
PREFERRED_VERSION_gcc-cross-${TARGET_ARCH} ?= "${GCCVERSION}"
PREFERRED_VERSION_gcc-crosssdk-${SDK_SYS} ?= "${SDKGCCVERSION}"
PREFERRED_VERSION_gcc-cross-canadian-${TRANSLATED_TARGET_ARCH} ?= "${GCCVERSION}"
PREFERRED_VERSION_gcc-runtime ?= "${GCCVERSION}"
PREFERRED_VERSION_gcc-sanitizers ?= "${GCCVERSION}"

PREFERRED_VERSION_nativesdk-gcc-runtime ?= "${SDKGCCVERSION}"
PREFERRED_VERSION_nativesdk-gcc-sanitizers ?= "${SDKGCCVERSION}"

PREFERRED_VERSION_libgcc ?= "${GCCVERSION}"
PREFERRED_VERSION_libgcc-initial ?= "${GCCVERSION}"

PREFERRED_VERSION_libgfortran ?= "${GCCVERSION}"

PREFERRED_VERSION_nativesdk-gcc ?= "${SDKGCCVERSION}"
PREFERRED_VERSION_nativesdk-libgcc ?= "${SDKGCCVERSION}"
PREFERRED_VERSION_nativesdk-libgcc-initial ?= "${SDKGCCVERSION}"

PREFERRED_VERSION_glibc = "${GLIBCVERSION}"
PREFERRED_VERSION_qemu = "${QEMUVERSION}"
QEMU_TARGETS = "riscv32 riscv64"
#qemu isnt building yet.... 
#MACHINE_FEATURES_BACKFILL_CONSIDERED = "qemu-usermode"

#PREFERRED_VERSION_binutils ?= "${BINUVERSION}"
#PREFERRED_VERSION_binutils-native ?= "${BINUVERSION}"
#PREFERRED_VERSION_binutils-cross-${TARGET_ARCH} ?= "${BINUVERSION}"
#PREFERRED_VERSION_binutils-crosssdk-${SDK_SYS} ?= "${BINUVERSION}"
#PREFERRED_VERSION_binutils-cross-canadian-${TRANSLATED_TARGET_ARCH} ?= "${BINUVERSION}"

# TCMODEOVERRIDES .= ":tcmode-external-sourcery-rebuild-libc"

# SKIP_RECIPE[glibc] = ""
# PREFERRED_PROVIDER_glibc = "glibc"
# PREFERRED_PROVIDER_virtual/libc = "glibc"
# PREFERRED_PROVIDER_virtual/libintl = "glibc"
# PREFERRED_PROVIDER_virtual/libiconv = "glibc"
#EXTERNAL_TOOLCHAIN ?= "${TOPDIR}/../tmp/Xuantie-900-gcc-linux-5.10.4-glibc-x86_64-V2.6.1/"
#EXTERNAL_TOOLCHAIN ?= "${TOPDIR}/../tmp/riscv-toolchain/"
#SYSROOT_PREFIX = ""
#GLIBC_GIT_URI = "git://git@gitee.com/t-head-linux/glibc.git;protocol=https"
#GLIBC_GIT_URI = "git://github.com/T-head-Semi/glibc.git;branch=riscv-glibc-2.33-thead;protocol=https"
#BINUTILS_GIT_URI = "git://github.com/T-head-Semi/binutils-gdb.git;branch=xuantie-binutils-gdb-2.35;protocol=https"
#BINUTILS_GIT_URI ?= "git://git@gitee.com/t-head-linux/binutils-gdb.git;branch=binutils-2_35-branch;protocol=https"
#GCC_GIT_URI = "git://github.com/T-head-Semi/gcc.git;branch=xuantie-gcc-10.2.0;protocol=https"
#TCMODE="external"
#TARGET_PREFIX="riscv64-linux-"
#TARGET_ARCH="riscv64"
#TARGET_OS="linux"
#QEMU_TOOLCHAIN_PATH="${TOPDIR}/../../riscv-toolchain/csky-qemu/bin/"
#SYSROOT_PREFIX ??= "riscv64-buildroot-linux-gnu"
#EXTERNAL_TOOLCHAIN_SYSROOT="${EXTERNAL_TOOLCHAIN}/${SYSROOT_PREFIX}/sysroot/"
```
